## firmware/components/sdf_config/Kconfig
```kconfig
menu "SDF Config"

menu "Platform"

        config SDF_PLATFORM_ENABLE_LIGHT_SLEEP
            bool "Enable light sleep support"
            default y
            help
                Enable light sleep power management features.

        config SDF_PLATFORM_ENABLE_DEEP_SLEEP
            bool "Enable deep sleep support"
            default n
            help
                Enable deep sleep power management features (requires RTC GPIO support).

        config SDF_PLATFORM_NVS_ENCRYPTION
            bool "Require NVS encryption at boot"
            default y
            help
                Verify NVS encryption is enabled and keys partition exists at startup.

        config SDF_PLATFORM_WDT_TIMEOUT_MS
            int "Task watchdog timeout (ms)"
            default 15000
            range 5000 60000
            help
                Task watchdog timeout in milliseconds.

        config SDF_WS2812_LED_GPIO
            int "WS2812 RGB LED GPIO"
            range -1 30
            default 8
            help
                GPIO to drive the onboard WS2812 RGB LED. Set to -1 to disable.

        config SDF_ENROLLMENT_BTN_GPIO
            int "Enrollment Button GPIO"
            range -1 30
            default 4
            help
                GPIO used for the local hardware enrollment button. Set to -1 to disable.

        config SDF_BATTERY_ADC_PIN
            int "Battery ADC pin"
            range -1 47
            default 5
            help
                GPIO used for battery voltage ADC sampling. Set to -1 to disable.

    endmenu

menu "Power"

        config SDF_POWER_CHECKIN_INTERVAL_MS
            int "Zigbee check-in interval (ms)"
            range 1000 600000
            default 15000
            help
                Period used for sleepy-end-device timer wakeups and Zigbee keep-alive.

        config SDF_POWER_IDLE_BEFORE_SLEEP_MS
            int "Idle before light sleep (ms)"
            range 500 600000
            default 5000
            help
                Minimum inactivity window before entering light sleep.

        config SDF_POWER_POST_WAKE_GUARD_MS
            int "Post-wake guard window (ms)"
            range 100 60000
            default 1500
            help
                Guard time after waking before sleep can be entered again.

        config SDF_POWER_LOOP_INTERVAL_MS
            int "Power task loop interval (ms)"
            range 50 10000
            default 250
            help
                Scheduler interval for the power manager task.

        config SDF_POWER_BATTERY_REPORT_INTERVAL_MS
            int "Battery report interval (ms)"
            range 1000 86400000
            default 60000
            help
                Interval for periodic battery attribute updates.

        config SDF_POWER_NUKI_STATE_POLL_INTERVAL_MS
            int "Nuki state poll interval (ms)"
            range 1000 86400000
            default 15000
            help
                Interval for periodic Nuki keyturner state polling. Defaults to same as check-in interval.

        config SDF_POWER_BATTERY_DEFAULT_PERCENT
            int "Default battery percent"
            range 0 100
            default 100
            help
                Fallback battery percentage used at boot before sampling.

        config SDF_POWER_FP_WAKE_GPIO
            int "Fingerprint WAKE GPIO"
            range -1 30
            default 3
            help
                GPIO used as fingerprint wake source. Set to -1 to disable GPIO wake.

        config SDF_POWER_FP_EN_GPIO
            int "Fingerprint Power Enable GPIO"
            range -1 30
            default 2
            help
                GPIO used to enable/disable power to the fingerprint sensor. Set to -1 to disable.

        config SDF_POWER_ENABLE_LIGHT_SLEEP
            bool "Enable light sleep"
            default y
            help
                Enables timer/GPIO wake based light sleep operation.

        config SDF_POWER_ENABLE_BLE_RADIO_GATING
            bool "Enable BLE radio gating while sleeping"
            default y
            help
                Temporarily disables BLE scanning/connection while sleeping.

        menu "SDF Power Manager - Deep Sleep"

            config SDF_POWER_ENABLE_DEEP_SLEEP
                bool "Enable deep sleep (vs light sleep only)"
                default y
                help
                    Enable deep sleep with configurable wake sources and retention memory.

            config SDF_POWER_WAKE_SOURCE_TIMER
                bool "Timer wake source (Zigbee check-in)"
                default y
                help
                    Enable timer-based wake for Zigbee check-in.

            config SDF_POWER_WAKE_SOURCE_FINGERPRINT
                bool "Fingerprint GPIO wake source"
                default y
                help
                    Enable fingerprint sensor WAKE pin as deep sleep wake source.

            config SDF_POWER_WAKE_SOURCE_USB
                bool "USB connection wake source"
                default y
                help
                    Enable USB connection as wake source.

            config SDF_POWER_WAKE_SOURCE_BLE
                bool "BLE activity wake source (experimental)"
                default n
                help
                    Enable BLE activity as wake source.

            config SDF_POWER_RETENTION_SIZE
                int "RTC retention memory size (bytes)"
                range 64 4096
                default 256
                help
                    Size of RTC slow memory reserved for retention state.

            config SDF_POWER_ADAPTIVE_CHECKIN
                bool "Adaptive check-in interval based on battery"
                default y
                help
                    Adjust check-in interval based on battery level.

            config SDF_POWER_STAGED_WAKE
                bool "Enable staged wake sequence"
                default y
                help
                    Enable staged wake: critical -> fast path (BLE) -> full path (Zigbee).

        endmenu

    endmenu

menu "Fingerprint"

        config SDF_FP_TX_PIN
            int "Fingerprint UART TX GPIO"
            range -1 47
            default 0
            help
                GPIO used for fingerprint sensor UART TX.

        config SDF_FP_RX_PIN
            int "Fingerprint UART RX GPIO"
            range -1 47
            default 1
            help
                GPIO used for fingerprint sensor UART RX.

        config SDF_FP_UART_PORT
            int "Fingerprint UART port"
            range 0 2
            default 1
            help
                UART peripheral number for the fingerprint sensor.

        config SDF_FP_BAUD_RATE
            int "Fingerprint UART baud rate"
            default 115200
            help
                Baud rate for fingerprint sensor UART communication.

        config SDF_FP_RESPONSE_TIMEOUT_MS
            int "Fingerprint response timeout (ms)"
            default 12000
            help
                Maximum time to wait for a response from the fingerprint sensor.

        config SDF_FP_RX_BUFFER_SIZE
            int "Fingerprint RX buffer size (bytes)"
            default 256
            help
                Size of the UART receive buffer for the fingerprint sensor.

        config SDF_FP_TX_BUFFER_SIZE
            int "Fingerprint TX buffer size (bytes)"
            default 256
            help
                Size of the UART transmit buffer for the fingerprint sensor.

    endmenu

menu "Security"

        config SDF_SECURITY_NONCE_REPLAY_WINDOW
            int "BLE nonce replay window size"
            range 1 16
            default 8
            help
                Number of recently accepted encrypted-message nonces to track per
                authorization ID. Reused nonces in this window are rejected.

        config SDF_SECURITY_BIOMETRIC_FAIL_THRESHOLD
            int "Biometric failed-attempt threshold"
            range 1 20
            default 5
            help
                Number of failed fingerprint matches allowed inside the configured
                attempt window before lockout is activated.

        config SDF_SECURITY_BIOMETRIC_FAIL_WINDOW_MS
            int "Biometric failed-attempt window (ms)"
            range 1000 600000
            default 60000
            help
                Sliding time window used to count failed fingerprint matches.

        config SDF_SECURITY_BIOMETRIC_LOCKOUT_MS
            int "Biometric lockout duration (ms)"
            range 1000 3600000
            default 120000
            help
                Duration of the temporary lockout after failed-attempt threshold
                has been reached.

        config SDF_SECURITY_REQUIRE_ENCRYPTED_NVS
            bool "Require encrypted NVS policy at boot"
            default y
            help
                Fail secure-storage initialization if encrypted NVS is not enabled or
                no NVS keys partition is present.

    endmenu

menu "Match"

        config SDF_MATCH_POLL_INTERVAL_MS
            int "Fingerprint match poll interval (ms)"
            default 400
            help
                Interval in milliseconds between fingerprint match polling checks.

        config SDF_MATCH_COOLDOWN_MS
            int "Fingerprint match cooldown (ms)"
            default 3000
            help
                Cooldown period in milliseconds after a fingerprint match attempt.

    endmenu

menu "OTA"

        config SDF_OTA_ENABLE
            bool "Enable OTA update mechanism"
            default y
            help
              Enable the sdf_ota component for managing OTA updates.

        config SDF_OTA_SIGNATURE_VERIFY
            bool "Verify Ed25519 signature on OTA image"
            default n
            depends on SDF_OTA_ENABLE
            help
              Verify Ed25519 signature before committing OTA image.
              Requires mbedTLS with ed25519 support (CONFIG_MBEDTLS_ECP_DP_CURVE25519_ENABLED).

        config SDF_OTA_ALLOW_DOWNGRADE
            bool "Allow firmware downgrades"
            default y
            depends on SDF_OTA_ENABLE
            help
              Allow OTA to proceed when incoming version is older than current.
              When disabled, downgrades will be rejected.

        config SDF_OTA_BOOTLOADER_ROLLBACK
            bool "Enable bootloader automatic rollback"
            default y
            depends on SDF_OTA_ENABLE
            help
              Enable ESP-IDF bootloader rollback feature (CONFIG_BOOTLOADER_APP_ROLLBACK_ENABLE).
              Requires bootloader to be built with this option.

        config SDF_OTA_ZIGBEE_QUERY_INTERVAL_HOURS
            int "Zigbee OTA query interval (hours)"
            default 24
            range 1 168
            depends on SDF_OTA_ENABLE
            help
              How often the Zigbee OTA client queries the coordinator for updates.
              Default is 24 hours (once per day).

    endmenu

menu "BLE"

        choice SDF_BLE_CONNECTION_MODE
            prompt "BLE connection policy"
            default SDF_BLE_CONNECTION_MODE_ALWAYS_CONNECTED
            help
                Controls whether the firmware keeps the Nuki BLE link active
                continuously or connects only when pairing or an action requires it.

        config SDF_BLE_CONNECTION_MODE_ALWAYS_CONNECTED
            bool "Stay connected all the time"
            help
                Start scanning automatically when a target address is available and
                reconnect automatically after disconnects.

        config SDF_BLE_CONNECTION_MODE_ON_DEMAND
            bool "Connect on demand"
            help
                Defer scanning until pairing or a lock-state / lock-action request
                needs the transport, then release the BLE link again once the request
                completes.

        endchoice

        config SDF_BLE_CONNECT_TIMEOUT_MS
            int "BLE connection attempt timeout (ms)"
            range 1000 30000
            default 10000
            help
                Maximum duration to wait for a BLE connection to complete.
                If the connection is not established within this time,
                ble_gap_conn_cancel() is called and a reconnect is scheduled.

        config SDF_BLE_RECONNECT_BASE_DELAY_MS
            int "Reconnect base delay (ms)"
            range 100 10000
            default 1000
            help
                Initial delay before the first reconnection attempt.
                Each subsequent attempt doubles this delay up to the maximum.

        config SDF_BLE_RECONNECT_MAX_DELAY_MS
            int "Reconnect maximum delay (ms)"
            range 1000 120000
            default 30000
            help
                Upper bound for the exponential backoff delay between
                reconnection attempts.

        config SDF_BLE_RECONNECT_MAX_RETRIES
            int "Maximum reconnect attempts (0=unlimited)"
            range 0 100
            default 10
            help
                Maximum number of consecutive reconnection attempts before
                giving up. Set to 0 for unlimited retries. After exhaustion,
                sdf_nuki_ble_start() must be called again to restart.

    endmenu

menu "Zigbee"

        config SDF_ZIGBEE_ENABLE
            bool "Enable Zigbee functionality"
            default y
            help
                Enable the Zigbee stack and Zigbee-facing application behavior.
                Disable this to run the device without Zigbee and allow the power
                manager to treat the device as standalone when idle.

        config SDF_ZIGBEE_SLEEP_THRESHOLD_MS
            int "Minimum idle time before Zigbee sleep (ms)"
            range 10 5000
            default 20
            help
                The Zigbee stack will only enter sleep if the idle window
                is longer than this threshold. Low values save more power
                but increase wake transitions.

        config SDF_ZIGBEE_SLEEP_ENABLE
            bool "Enable Zigbee sleepy end-device mode"
            default y
            help
                Enable light-sleep for the Zigbee radio between check-in polls.
                Requires CONFIG_PM_ENABLE and CONFIG_FREERTOS_USE_TICKLESS_IDLE.

    endmenu

menu "CLI"

        config SDF_CLI_PASSWORD
            string "CLI Login Password"
            default "admin123"
            help
                The password required to access the USB-C Command Line Interface.

    endmenu

menu "Event Router"

        config SDF_EVENT_ROUTER_QUEUE_DEPTH
            int "Event router queue depth"
            range 8 64
            default 32
            help
                Number of events that can be queued for async dispatch.

        config SDF_EVENT_ROUTER_ENABLE_AUDIT
            bool "Enable audit logging"
            default y
            help
                When enabled, all events are automatically logged to the audit trail.

    endmenu

menu "Config"

        config SDF_CONFIG_ENABLE_RUNTIME_OVERRIDE
            bool "Enable runtime configuration override"
            default n
            help
                Allow configuration values to be overridden at runtime via API.

        config SDF_CONFIG_VALIDATE_AT_BOOT
            bool "Validate configuration at boot"
            default y
            help
                Run configuration validation checks during initialization.

        config SDF_CONFIG_DEBUG_LOG
            bool "Enable config debug logging"
            default n
            help
                Enable verbose debug logging for configuration subsystem.

    endmenu

endmenu
```

## firmware/components/sdf_event_router/Kconfig
```kconfig
menu "SDF Event Router"

config SDF_EVENT_ROUTER_QUEUE_DEPTH
    int "Event router queue depth"
    range 8 64
    default 32
    help
        Number of events that can be queued for async dispatch.

config SDF_EVENT_ROUTER_ENABLE_AUDIT
    bool "Enable audit logging"
    default y
    help
        When enabled, all events are automatically logged to the audit trail.

endmenu
```

## firmware/components/sdf_ota/Kconfig
```kconfig
menu "SDF OTA Configuration"

config SDF_OTA_ENABLE
    bool "Enable OTA update mechanism"
    default y
    help
      Enable the sdf_ota component for managing OTA updates.

config SDF_OTA_SIGNATURE_VERIFY
    bool "Verify Ed25519 signature on OTA image"
    default n
    depends on SDF_OTA_ENABLE
    help
      Verify Ed25519 signature before committing OTA image.
      Requires mbedTLS with ed25519 support (CONFIG_MBEDTLS_ECP_DP_CURVE25519_ENABLED).

config SDF_OTA_ALLOW_DOWNGRADE
    bool "Allow firmware downgrades"
    default y
    depends on SDF_OTA_ENABLE
    help
      Allow OTA to proceed when incoming version is older than current.
      When disabled, downgrades will be rejected.

config SDF_OTA_BOOTLOADER_ROLLBACK
    bool "Enable bootloader automatic rollback"
    default y
    depends on SDF_OTA_ENABLE
    help
      Enable ESP-IDF bootloader rollback feature (CONFIG_BOOTLOADER_APP_ROLLBACK_ENABLE).
      Requires bootloader to be built with this option.

config SDF_OTA_ZIGBEE_QUERY_INTERVAL_HOURS
    int "Zigbee OTA query interval (hours)"
    default 24
    range 1 168
    depends on SDF_OTA_ENABLE
    help
      How often the Zigbee OTA client queries the coordinator for updates.
      Default is 24 hours (once per day).

endmenu
```

## firmware/components/sdf_platform/Kconfig
```kconfig
menu "SDF Platform Configuration"

config SDF_PLATFORM_ENABLE_LIGHT_SLEEP
    bool "Enable light sleep support"
    default y
    help
        Enable light sleep power management features.

config SDF_PLATFORM_ENABLE_DEEP_SLEEP
    bool "Enable deep sleep support"
    default n
    help
        Enable deep sleep power management features (requires RTC GPIO support).

config SDF_PLATFORM_NVS_ENCRYPTION
    bool "Require NVS encryption at boot"
    default y
    help
        Verify NVS encryption is enabled and keys partition exists at startup.

config SDF_PLATFORM_WDT_TIMEOUT_MS
    int "Task watchdog timeout (ms)"
    default 15000
    range 5000 60000
    help
        Task watchdog timeout in milliseconds.

endmenu
```

## firmware/components/sdf_power/Kconfig
```kconfig
menu "SDF Power Manager"

config SDF_POWER_CHECKIN_INTERVAL_MS
    int "Zigbee check-in interval (ms)"
    range 1000 600000
    default 15000
    help
        Period used for sleepy-end-device timer wakeups and Zigbee keep-alive.

config SDF_POWER_IDLE_BEFORE_SLEEP_MS
    int "Idle before light sleep (ms)"
    range 500 600000
    default 5000
    help
        Minimum inactivity window before entering light sleep.

config SDF_POWER_POST_WAKE_GUARD_MS
    int "Post-wake guard window (ms)"
    range 100 60000
    default 1500
    help
        Guard time after waking before sleep can be entered again.

config SDF_POWER_LOOP_INTERVAL_MS
    int "Power task loop interval (ms)"
    range 50 10000
    default 250
    help
        Scheduler interval for the power manager task.

config SDF_POWER_BATTERY_REPORT_INTERVAL_MS
    int "Battery report interval (ms)"
    range 1000 86400000
    default 60000
    help
        Interval for periodic battery attribute updates.

config SDF_POWER_BATTERY_DEFAULT_PERCENT
    int "Default battery percent"
    range 0 100
    default 100
    help
        Fallback battery percentage used at boot before sampling.

config SDF_POWER_FP_WAKE_GPIO
    int "Fingerprint WAKE GPIO"
    range -1 30
    default 3
    help
        GPIO used as fingerprint wake source. Set to -1 to disable GPIO wake.

config SDF_POWER_FP_EN_GPIO
    int "Fingerprint Power Enable GPIO"
    range -1 30
    default 2
    help
        GPIO used to enable/disable power to the fingerprint sensor. Set to -1 to disable.

config SDF_ENROLLMENT_BTN_GPIO
    int "Enrollment Button GPIO"
    range -1 30
    default 14
    help
        GPIO used for the local hardware enrollment button. Set to -1 to disable.

config SDF_WS2812_LED_GPIO
    int "WS2812 RGB LED GPIO"
    range -1 30
    default 8
    help
        GPIO to drive the onboard WS2812 RGB LED. Set to -1 to disable.

config SDF_POWER_ENABLE_LIGHT_SLEEP
    bool "Enable light sleep"
    default y
    help
        Enables timer/GPIO wake based light sleep operation.

config SDF_POWER_ENABLE_BLE_RADIO_GATING
    bool "Enable BLE radio gating while sleeping"
    default y
    help
        Temporarily disables BLE scanning/connection while sleeping.

menu "SDF Power Manager - Deep Sleep"

config SDF_POWER_ENABLE_DEEP_SLEEP
    bool "Enable deep sleep (vs light sleep only)"
    default y
    help
        Enable deep sleep with configurable wake sources and retention memory.

config SDF_POWER_WAKE_SOURCE_TIMER
    bool "Timer wake source (Zigbee check-in)"
    default y
    help
        Enable timer-based wake for Zigbee check-in.

config SDF_POWER_WAKE_SOURCE_FINGERPRINT
    bool "Fingerprint GPIO wake source"
    default y
    help
        Enable fingerprint sensor WAKE pin as deep sleep wake source.

config SDF_POWER_WAKE_SOURCE_USB
    bool "USB connection wake source"
    default y
    help
        Enable USB connection as wake source.

config SDF_POWER_WAKE_SOURCE_BLE
    bool "BLE activity wake source (experimental)"
    default n
    help
        Enable BLE activity as wake source.

config SDF_POWER_RETENTION_SIZE
    int "RTC retention memory size (bytes)"
    range 64 4096
    default 256
    help
        Size of RTC slow memory reserved for retention state.

config SDF_POWER_ADAPTIVE_CHECKIN
    bool "Adaptive check-in interval based on battery"
    default y
    help
        Adjust check-in interval based on battery level.

config SDF_POWER_STAGED_WAKE
    bool "Enable staged wake sequence"
    default y
    help
        Enable staged wake: critical -> fast path (BLE) -> full path (Zigbee).

endmenu

endmenu
```

## firmware/ota_signature_gate/main/Kconfig.projbuild
```kconfig
menu "OTA Signature Gate fixture (task 4.4 self-test only)"

    choice GATE_SELF_TEST_MODE
        prompt "Case scope this build runs"
        default GATE_SELF_TEST_MODE_FULL
        help
            The real gate (default) always runs all three cases in order:
            reject (tampered), reject (foreign key), accept (valid) - D5.

            Task 4.4 needs a build with signature verification compiled out
            in which the tampered and foreign-key cases are both *accepted*
            (design.md D3's discriminating self-test). sdf_ota_verify_and_
            commit() reboots unconditionally on a successful commit
            (sdf_ota.c:472) and does not return, so two cases that both
            accept cannot both run to completion in the same boot. These
            two extra choices let the self-test exercise the tampered and
            foreign-key cases as two separate emulator runs of the same
            no-verify build instead. Never used by the real gate; only
            selected by scripts/run_ota_signature_gate.sh --no-verify via
            sdkconfig.no_verify_tampered.defaults / sdkconfig.no_verify_
            foreign_key.defaults.

        config GATE_SELF_TEST_MODE_FULL
            bool "Run all three cases (real gate)"

        config GATE_SELF_TEST_MODE_TAMPERED_ONLY
            bool "Run only the tampered case, expecting ACCEPT (task 4.4)"

        config GATE_SELF_TEST_MODE_FOREIGN_KEY_ONLY
            bool "Run only the foreign-key case, expecting ACCEPT (task 4.4)"
    endchoice

endmenu
```

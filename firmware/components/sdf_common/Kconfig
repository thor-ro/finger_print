## firmware/components/sdf_common/Kconfig
```kconfig
menu "SDF Security & Hardening"

config SDF_SECURITY_NONCE_REPLAY_WINDOW
    int "BLE nonce replay window size"
    range 1 16
    default 8
    help
        Number of recently accepted encrypted-message nonces to track per
        authorization ID. Reused nonces in this window are rejected.

config SDF_SECURITY_BIOMETRIC_FAIL_THRESHOLD
    int "Biometric failed-attempt threshold"
    range 1 20
    default 5
    help
        Number of failed fingerprint matches allowed inside the configured
        attempt window before lockout is activated.

config SDF_SECURITY_BIOMETRIC_FAIL_WINDOW_MS
    int "Biometric failed-attempt window (ms)"
    range 1000 600000
    default 60000
    help
        Sliding time window used to count failed fingerprint matches.

config SDF_SECURITY_BIOMETRIC_LOCKOUT_MS
    int "Biometric lockout duration (ms)"
    range 1000 3600000
    default 120000
    help
        Duration of the temporary lockout after failed-attempt threshold
        has been reached.

config SDF_SECURITY_REQUIRE_ENCRYPTED_NVS
    bool "Require encrypted NVS policy at boot"
    default y
    help
        Fail secure-storage initialization if encrypted NVS is not enabled or
        no NVS keys partition is present.

endmenu
```

## firmware/components/sdf_protocol_ble/Kconfig
```kconfig
menu "SDF BLE Transport"

choice SDF_BLE_CONNECTION_MODE
    prompt "BLE connection policy"
    default SDF_BLE_CONNECTION_MODE_ALWAYS_CONNECTED
    help
        Controls whether the firmware keeps the Nuki BLE link active
        continuously or connects only when pairing or an action requires it.

config SDF_BLE_CONNECTION_MODE_ALWAYS_CONNECTED
    bool "Stay connected all the time"
    help
        Start scanning automatically when a target address is available and
        reconnect automatically after disconnects.

config SDF_BLE_CONNECTION_MODE_ON_DEMAND
    bool "Connect on demand"
    help
        Defer scanning until pairing or a lock-state / lock-action request
        needs the transport, then release the BLE link again once the request
        completes.

endchoice

config SDF_BLE_CONNECT_TIMEOUT_MS
    int "BLE connection attempt timeout (ms)"
    range 1000 30000
    default 10000
    help
        Maximum duration to wait for a BLE connection to complete.
        If the connection is not established within this time,
        ble_gap_conn_cancel() is called and a reconnect is scheduled.

config SDF_BLE_RECONNECT_BASE_DELAY_MS
    int "Reconnect base delay (ms)"
    range 100 10000
    default 1000
    help
        Initial delay before the first reconnection attempt.
        Each subsequent attempt doubles this delay up to the maximum.

config SDF_BLE_RECONNECT_MAX_DELAY_MS
    int "Reconnect maximum delay (ms)"
    range 1000 120000
    default 30000
    help
        Upper bound for the exponential backoff delay between
        reconnection attempts.

config SDF_BLE_RECONNECT_MAX_RETRIES
    int "Maximum reconnect attempts (0=unlimited)"
    range 0 100
    default 10
    help
        Maximum number of consecutive reconnection attempts before
        giving up. Set to 0 for unlimited retries. After exhaustion,
        sdf_nuki_ble_start() must be called again to restart.

endmenu
```

## firmware/components/sdf_protocol_zigbee/Kconfig
```kconfig
menu "SDF Zigbee"

config SDF_ZIGBEE_ENABLE
    bool "Enable Zigbee functionality"
    default y
    help
        Enable the Zigbee stack and Zigbee-facing application behavior.
        Disable this to run the device without Zigbee and allow the power
        manager to treat the device as standalone when idle.

config SDF_ZIGBEE_SLEEP_THRESHOLD_MS
    int "Minimum idle time before Zigbee sleep (ms)"
    range 10 5000
    default 20
    help
        The Zigbee stack will only enter sleep if the idle window
        is longer than this threshold. Low values save more power
        but increase wake transitions.

config SDF_ZIGBEE_SLEEP_ENABLE
    bool "Enable Zigbee sleepy end-device mode"
    default y
    help
        Enable light-sleep for the Zigbee radio between check-in polls.
        Requires CONFIG_PM_ENABLE and CONFIG_FREERTOS_USE_TICKLESS_IDLE.

endmenu
```

## firmware/components/sdf_tasks/Kconfig
```kconfig
menu "SDF Power Manager"

config SDF_POWER_CHECKIN_INTERVAL_MS
    int "Zigbee check-in interval (ms)"
    range 1000 600000
    default 15000
    help
        Period used for sleepy-end-device timer wakeups and Zigbee keep-alive.

config SDF_POWER_IDLE_BEFORE_SLEEP_MS
    int "Idle before light sleep (ms)"
    range 500 600000
    default 5000
    help
        Minimum inactivity window before entering light sleep.

config SDF_POWER_POST_WAKE_GUARD_MS
    int "Post-wake guard window (ms)"
    range 100 60000
    default 1500
    help
        Guard time after waking before sleep can be entered again.

config SDF_POWER_LOOP_INTERVAL_MS
    int "Power task loop interval (ms)"
    range 50 10000
    default 250
    help
        Scheduler interval for the power manager task.

config SDF_POWER_BATTERY_REPORT_INTERVAL_MS
    int "Battery report interval (ms)"
    range 1000 86400000
    default 60000
    help
        Interval for periodic battery attribute updates.

config SDF_POWER_BATTERY_DEFAULT_PERCENT
    int "Default battery percent"
    range 0 100
    default 100
    help
        Fallback battery percentage used at boot before sampling.

config SDF_POWER_FP_WAKE_GPIO
    int "Fingerprint WAKE GPIO"
    range -1 30
    default 6
    help
        GPIO used as fingerprint wake source. Set to -1 to disable GPIO wake.

config SDF_POWER_FP_EN_GPIO
    int "Fingerprint Power Enable GPIO"
    range -1 30
    default 7
    help
        GPIO used to enable/disable power to the fingerprint sensor. Set to -1 to disable.

config SDF_POWER_ENABLE_LIGHT_SLEEP
    bool "Enable light sleep"
    default y
    help
        Enables timer/GPIO wake based light sleep operation.

config SDF_POWER_ENABLE_BLE_RADIO_GATING
    bool "Enable BLE radio gating while sleeping"
    default y
    help
        Temporarily disables BLE scanning/connection while sleeping.

endmenu
```
